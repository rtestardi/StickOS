// *** jm.c ***********************************************************

#include "main.h"

#define SCROLL_MS  50

static uint16 rows[5];
static uint16 scroll[5];
static byte row;

static char scroll_buf[BASIC_OUTPUT_LINE_SIZE];
static int scroll_col;

extern const unsigned char font[][5];

static
bool
jm_letter(int c, char letter)
{
    int r;
    static bool last;
    
    assert(c >= 0 && c < 6);
    
    if (c == 5 && ! last) {
        return true;
    }
    
    last = false;
    for (r = 0; r < 5; r++) {
        scroll[r] >>= 1;
        if (c == 5) {
            continue;
        }
        if (font[letter - ' '][c] & (1<<r)) {
            scroll[r] |= (1<<15);
            last = true;
        }
    }
    
    return false;
}

void
jm_timer_poll()
{
    bool again;
    char letter;
    static int calls;
    
    // display the next row
    row = (++row%5);
    
    PTAD = (PTAD & ~0x1f) | (1<<row);
    if (! zb_present) {
        PTED = (byte)~(rows[row]^scroll[row]);
    }
    PTDD = (byte)~((rows[row]^scroll[row])>>8);
    
    if (++calls == SCROLL_MS) {
        // scroll the text
        calls = 0;
        
        do {
            letter = scroll_buf[0];
            if (letter < ' ' || letter >= 0x80) {
                letter = ' ';
            }
        
            again = jm_letter(scroll_col, letter);
            
            if (scroll_buf[0]) {
                scroll_col = ++scroll_col%6;
            }
            
            if (! scroll_col) {
                memmove(scroll_buf, scroll_buf+1, sizeof(scroll_buf)-1);
                scroll_buf[sizeof(scroll_buf)-1] = '\0';
            }
        } while (again);
    }
}

void
jm_set(int r_in, int c_in)
{
    int r;
    int c;
    
    for (r = 0; r < 5; r++) {
        for (c = 0; c < 16; c++) {
            if ((r == r_in || r_in == -1) && (c == c_in || c_in == -1)) {
                rows[r] |= 1<<c;
            }
        }
    }
}

void
jm_clear(int r_in, int c_in)
{
    int r;
    int c;
    
    for (r = 0; r < 5; r++) {
        for (c = 0; c < 16; c++) {
            if ((r == r_in || r_in == -1) && (c == c_in || c_in == -1)) {
                rows[r] &= ~(1<<c);
            }
        }
    }
}

void
jm_scroll(char *text, int length)
{
    strncat(scroll_buf, text, length);
    assert(strlen(scroll_buf) < sizeof(scroll_buf));
}

bool
jm_scroll_ready()
{
    return ! scroll_buf[0];
}

void
jm_initialize(void)
{
    // set the led matrix pins to digital output
    // N.B. we don't use PTE4-7 if zigbee is present on qspi pins
    PTADD = 0x1f;
    PTADS = 0x1f;
    if (! zb_present) {
        PTEDD = 0xff;
        PTEDS = 0xff;
        SPI1C1 = 0;  // qspi off
    }
    PTDDD = 0xff;
    PTDDS = 0xff;
    
    // we start with a message...
#if STICKOS
    if (var_get_flash(FLASH_AUTORUN) != 1) {
        jm_scroll(help_about_short, strlen(help_about_short));
    }
#endif
}

/*! ASCII Font Table for 5x5 Character Set */
const unsigned char font[][5] = 
{ 
  { 0b00000, 0b00000, 0b00000, 0b00000, 0b00000 }, // Space
  { 0b00000, 0b00000, 0b10111, 0b00000, 0b00000 }, // !
  { 0b00100, 0b00011, 0b00100, 0b00011, 0b00000 }, // "
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  { 0b11111, 0b11111, 0b11111, 0b11111, 0b11111 }, // 
};

